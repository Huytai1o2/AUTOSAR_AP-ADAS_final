AUTOSAR XML (schema 00049)
package /DataType/Implementation/CPP
  14 x std cpp implementation data type:
    bool: category=VALUE, type-emitter=FundamentalType
    double: category=VALUE, type-emitter=FundamentalType
    ext: category=STRING
      namespaces:
        symbol props imageString
    float: category=VALUE, type-emitter=FundamentalType
    imageData: category=VECTOR, cpp-template-argument=int8_t
    imageImencode: category=STRUCTURE
      namespaces:
        symbol props opencvMAT
      cpp implementation data type element bufferImg: type-reference=imageData
      cpp implementation data type element ext: type-reference=ext
    int16_t: category=VALUE, header-file=cstdint
    int32_t: category=VALUE, header-file=cstdint
    int64_t: category=VALUE, header-file=cstdint
    int8_t: category=VALUE, header-file=cstdint
    uint16_t: category=VALUE, header-file=cstdint
    uint32_t: category=VALUE, header-file=cstdint
    uint64_t: category=VALUE, header-file=cstdint
    uint8_t: category=VALUE, header-file=cstdint
package /Platform
  machine HPC_DDS_Machine: machine-design=HPC_DDS, trusted-platform-executable-launch-behavior=NO-TRUSTED-PLATFORM-SUPPORT
    module-instantiations:
      generic module instantiation CmInstantiation: category=COMMUNICATION_MANAGEMENT
      log and trace instantiation LOG
        4 x dlt log channel, all with log-trace-log-modes=CONSOLE:
          CM: application-id=CM, context-id=CM, log-trace-default-log-level=ERROR
          ClientSensor: application-id=cSen, context-id=cSen, log-trace-default-log-level=VERBOSE
          EM: application-id=EM, context-id=EM, log-trace-default-log-level=ERROR
          ProviderSensor: application-id=pSen, context-id=pSen, log-trace-default-log-level=VERBOSE
      os module instantiation POSIX
        resource group ResourceGroup
    processor CPU
      processor core Core0: core-id=0
package /Platform/FunctionGroup
  function group set FunctionGroupSet
    function-groups:
      mode declaration group prototype MachineFG: type=MachineState
package /Platform/ProcessToMachine
  process to machine mapping set ProcessToHPC_DDS_MachineMapping
    4 x process to machine mapping, all with machine=HPC_DDS_Machine:
      CM_To_HPC_DDS_Machine_Mapping: process=CM
      ClientSensor_To_HPC_DDS_Machine_Mapping: process=ClientSensor
      EM_To_HPC_DDS_Machine_Mapping: process=EM
      ProviderSensor_To_HPC_DDS_Machine_Mapping: process=ProviderSensor
package /System
  system System: category=MACHINE_DESIGN_EXTRACT, system-version=1.0.0;R2011-PARA
    system mapping SystemMapping
      sw-mappings:
        swc to ecu mapping SwMapping0: component=System.HPC_DDS.HPC_DDS
    root-software-compositions:
      root sw composition prototype System: software-composition=System
package /System/Service/Deployment
  dds service interface deployment Sensor: service-interface=Sensor, field-reply-topic-name=ReturnField, field-request-topic-name=CallField, method-reply-topic-name=ReturnMethod, method-request-topic-name=CallMethod, service-interface-id=Sensor, transport-protocols=UDP
    dds event deployment imageData: event=imageDataEvent, topic-name=imageData
package /System/Service/Endpoint
  dds service instance to machine mapping DdsServiceInstanceToMachineMapping0: communication-connector=eth0, service-instance=[Consumer_Sensor, Provider_Sensor]
package /System/Service/Instance
  dds required service instance Consumer_Sensor: service-interface-deployment=Sensor, qos-profile=DEFAULT, domain-id=0, required-service-instance-id=ANY
  dds provided service instance Provider_Sensor: service-interface-deployment=Sensor, qos-profile=DEFAULT, domain-id=0, service-instance-id=100
package /System/VehicleTopology/Cluster
  ethernet cluster EthernetCluster0
    ethernet physical channel PhysicalChannel: category=WIRED, comm-connectors=eth0
      network endpoint NetworkEndpoint0: network-endpoint-addresses=ipv-4-configuration={ipv-4-address=172.31.36.143, ipv-4-address-source=FIXED}
      network endpoint SdMulticast: network-endpoint-addresses=ipv-4-configuration={ipv-4-address=224.0.0.1, ipv-4-address-source=FIXED}
package /System/VehicleTopology/Ecu
  machine design HPC_DDS: service-discover-configs=someip-service-discovery={multicast-sd-ip-address=SdMulticast, someip-service-discovery-port=30490}
    ethernet communication connector eth0: unicast-network-endpoint=NetworkEndpoint0
package /SwComponent/AdaptiveApplication
  adaptive application sw component type CM
  adaptive application sw component type ClientSensor
    require port RPort0: required-interface=Sensor
  adaptive application sw component type EM
  adaptive application sw component type ProviderSensor
    provide port PPort0: provided-interface=Sensor
package /SwComponent/Composition
  composition sw component type HPC_DDS
    4 x component:
      CM: type=CM
      ClientSensor: type=ClientSensor
      EM: type=EM
      ProviderSensor: type=ProviderSensor
  composition sw component type System
    component HPC_DDS: type=HPC_DDS
package /PortInterface/Service
  service interface Sensor
    namespaces:
      symbol props sensorCam
    events:
      data imageDataEvent: type=imageData
    methods:
      operation requestData: fire-and-forget=false
        arg isRequest: type=bool, direction=IN
        arg imageDataOut: type=imageData, direction=OUT
package /AdaptiveApplication/DltConfig
  4 x dlt log channel to process mapping:
    DltLogChannelToProcessMapping_CM_TO_CM: dlt-log-channel=CM, process=CM
    DltLogChannelToProcessMapping_ClientSensor_TO_ClientSensor: dlt-log-channel=ClientSensor, process=ClientSensor
    DltLogChannelToProcessMapping_EM_TO_EM: dlt-log-channel=EM, process=EM
    DltLogChannelToProcessMapping_ProviderSensor_TO_ProviderSensor: dlt-log-channel=ProviderSensor, process=ProviderSensor
package /AdaptiveApplication/Executable
  4 x executable, all with logging-behavior=USES-LOGGING, version=1.0.0:
    CM: category=PLATFORM_LEVEL, reporting-behavior=DOES-NOT-REPORT-EXECUTION-STATE
      root sw component prototype PARA: application-type=CM
    ClientSensor: category=APPLICATION_LEVEL, reporting-behavior=REPORTS-EXECUTION-STATE
      root sw component prototype AA: application-type=ClientSensor
    EM: category=PLATFORM_LEVEL, reporting-behavior=DOES-NOT-REPORT-EXECUTION-STATE
      root sw component prototype PARA: application-type=EM
    ProviderSensor: category=APPLICATION_LEVEL, reporting-behavior=REPORTS-EXECUTION-STATE
      root sw component prototype AA: application-type=ProviderSensor
package /AdaptiveApplication/Manifest
  service instance to port prototype mapping ClientSensor_AA_RPort0: port-prototype=AA.RPort0, service-instance=Consumer_Sensor
  service instance to port prototype mapping ProviderSensor_AA_PPort0: port-prototype=AA.PPort0, service-instance=Provider_Sensor
package /AdaptiveApplication/Process
  4 x process:
    CM: executable=CM, state-dependent-startup-config{function-group-state=[MachineFG.Restart, MachineFG.Startup, MachineFG.Verify, MachineFG.Shutdown], resource-group=ResourceGroup, startup-config=CM}
      process state machine CM: type=ProcessState
    ClientSensor: executable=ClientSensor, state-dependent-startup-config{execution-dependency=ProviderSensor.Running, function-group-state=MachineFG.Startup, resource-group=ResourceGroup, startup-config=ClientSensor}
      process state machine ClientSensor: type=ProcessState
    EM: executable=EM
    ProviderSensor: executable=ProviderSensor, state-dependent-startup-config{execution-dependency=CM.Running, function-group-state=MachineFG.Startup, resource-group=ResourceGroup, startup-config=ProviderSensor}
      process state machine ProviderSensor: type=ProcessState
package /AdaptiveApplication/StartupConfig
  startup config set StartupConfig
    startup config CM: scheduling-policy=SCHED_OTHER, scheduling-priority=0, timeout={enter-timeout-value=1.0, exit-timeout-value=1.0}
    startup config ClientSensor: scheduling-policy=SCHED_OTHER, scheduling-priority=0, timeout={enter-timeout-value=1.0, exit-timeout-value=1.0}
    startup config ProviderSensor: scheduling-policy=SCHED_OTHER, scheduling-priority=0, timeout={enter-timeout-value=1.0, exit-timeout-value=1.0}
package /StateMachine
  mode declaration group MachineState: initial-mode=Off
    5 x mode:
      Off
      Restart
      Shutdown
      Startup
      Verify
  mode declaration group ProcessState: initial-mode=Idle
    4 x mode:
      Idle
      Running
      Starting
      Terminated
