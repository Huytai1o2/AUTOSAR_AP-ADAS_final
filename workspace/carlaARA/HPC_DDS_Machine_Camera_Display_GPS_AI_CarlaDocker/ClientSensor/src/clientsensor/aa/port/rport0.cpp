///////////////////////////////////////////////////////////////////////////////////////////////////////////
///                                                                                                        
/// Copyright, 2021 PopcornSAR Co., Ltd. All rights reserved.                                              
/// This software is copyright protected and proprietary to PopcornSAR Co., Ltd.                           
/// PopcornSAR Co., Ltd. grants to you only those rights as set out in the license conditions.             
///                                                                                                        
///////////////////////////////////////////////////////////////////////////////////////////////////////////
/// AUTOSAR VERSION                   : R20-11
/// GENERATED BY                      : PARA, Adaptive Application Generator
///////////////////////////////////////////////////////////////////////////////////////////////////////////
/// GENERATED FILE NAME               : rport0.cpp
/// SOFTWARE COMPONENT NAME           : RPort0
/// GENERATED DATE                    : 2026-03-05 23:25:53
///////////////////////////////////////////////////////////////////////////////////////////////////////////
#include "clientsensor/aa/port/rport0.h"
 
namespace clientsensor
{
namespace aa
{
namespace port
{
 
RPort0::RPort0()
    : m_logger(ara::log::CreateLogger("cSen", "PORT", ara::log::LogLevel::kVerbose))
    , m_running{false}
    , m_found{false}
    , m_receiverimageDataEvent{nullptr}
    , m_responderrequestData{nullptr}
{
}
 
RPort0::~RPort0()
{
}
 
void RPort0::Start()
{
    m_logger.LogVerbose() << "RPort0::Start";
    
    // regist callback
    ara::core::InstanceSpecifier specifier{"ClientSensor/AA/RPort0"};
    auto handler = [this](ara::com::ServiceHandleContainer<sensorCam::proxy::SensorProxy::HandleType> handles,
                          ara::com::FindServiceHandle findHandle) {
        this->Find(handles, findHandle);
    };
    
    // find service
    auto find = sensorCam::proxy::SensorProxy::StartFindService(handler, specifier);
    if (find.HasValue())
    {
        m_logger.LogVerbose() << "RPort0::Start::StartFindService";
    }
    else
    {
        m_logger.LogError() << "RPort0::Start::StartFindService::" << find.Error().Message();
    }
    
    // run port
    m_running = true;
}
 
void RPort0::Terminate()
{
    m_logger.LogVerbose() << "RPort0::Terminate";
    
    // stop port
    m_running = false;
    
    // clear service proxy
    if (m_interface)
    {
        // stop subscribe
        StopSubscribeimageDataEvent();
        
        // stop find service
        m_interface->StopFindService(*m_findHandle);
        m_found = false;
        
        m_logger.LogVerbose() << "RPort0::Terminate::StopFindService";
    }
}
 
void RPort0::Find(ara::com::ServiceHandleContainer<sensorCam::proxy::SensorProxy::HandleType> handles, ara::com::FindServiceHandle findHandle)
{
    // check finding handles
    if (handles.empty())
    {
        m_logger.LogVerbose() << "RPort0::Find::Service Instances not found";
        return;
    }
    else
    {
        for (auto& handle : handles)
        {
            m_logger.LogVerbose() << "RPort0::Find::Searched Instance::ServiceId =" << 
                                     handle.GetServiceHandle().serviceId << 
                                     ", InstanceId =" << 
                                     handle.GetServiceHandle().instanceId;
        }
    }
    
    // create proxy
    if (m_interface)
    {
        m_logger.LogVerbose() << "RPort0::Find::Proxy is already running";
    }
    else
    {
        m_logger.LogVerbose() << "RPort0::Find::Using Instance::ServiceId =" << 
                                 handles[0].GetServiceHandle().serviceId << 
                                 ", InstanceId =" << 
                                 handles[0].GetServiceHandle().instanceId;
        m_interface = std::make_unique<sensorCam::proxy::SensorProxy>(handles[0]);
        m_findHandle = std::make_unique<ara::com::FindServiceHandle>(findHandle);
        m_found = true;
        
        // subscribe events
        SubscribeimageDataEvent();
    }
}
 
void RPort0::SubscribeimageDataEvent()
{
    if (m_found)
    {
        // regist receiver handler
        // if you want to enable it, please uncomment below code
        RegistReceiverimageDataEvent();
        
        // request subscribe
        auto subscribe = m_interface->imageDataEvent.Subscribe(1);
        if (subscribe.HasValue())
        {
            m_logger.LogVerbose() << "RPort0::SubscribeimageDataEvent::Subscribed";
        }
        else
        {
            m_logger.LogError() << "RPort0::SubscribeimageDataEvent::" << subscribe.Error().Message();
        }
    }
}
 
void RPort0::StopSubscribeimageDataEvent()
{
    if (m_found)
    {
        // request stop subscribe
        m_interface->imageDataEvent.Unsubscribe();
        m_logger.LogVerbose() << "RPort0::StopSubscribeimageDataEvent::Unsubscribed";
    }
}
 
void RPort0::RegistReceiverimageDataEvent()
{
    if (m_found)
    {
        // set callback
        auto receiver = [this]() -> void {
            return ReceiveEventimageDataEventTriggered();
        };
        
        // regist callback
        auto callback = m_interface->imageDataEvent.SetReceiveHandler(receiver);
        if (callback.HasValue())
        {
            m_logger.LogVerbose() << "RPort0::RegistReceiverimageDataEvent::SetReceiveHandler";
        }
        else
        {
            m_logger.LogError() << "RPort0::RegistReceiverimageDataEvent::SetReceiveHandler::" << callback.Error().Message();
        }
    }
}
 
void RPort0::ReceiveEventimageDataEventTriggered()
{
    if (m_found)
    {
        std::lock_guard<std::mutex> lock(m_mutex);
        
        if (m_interface->imageDataEvent.GetSubscriptionState() == ara::com::SubscriptionState::kSubscribed)
        {
            auto recv = std::make_unique<ara::core::Result<size_t>>(m_interface->imageDataEvent.GetNewSamples([&](auto samplePtr) {
                RPort0::ReadDataimageDataEvent(std::move(samplePtr));
            }));
            if (recv->HasValue())
            {
                m_logger.LogVerbose() << "RPort0::ReceiveEventimageDataEvent::GetNewSamples::" << recv->Value();
            }
            else
            {
                m_logger.LogError() << "RPort0::ReceiveEventimageDataEvent::GetNewSamples::" << recv->Error().Message();
            }
        }
    }
}
 
void RPort0::ReceiveEventimageDataEventCyclic()
{
    while (m_running)
    {
        if (m_found)
        {
            std::lock_guard<std::mutex> lock(m_mutex);
            if (m_interface->imageDataEvent.GetSubscriptionState() == ara::com::SubscriptionState::kSubscribed)
            {
                auto recv = std::make_unique<ara::core::Result<size_t>>(m_interface->imageDataEvent.GetNewSamples([&](auto samplePtr) {
                    RPort0::ReadDataimageDataEvent(std::move(samplePtr));
                }));
                if (recv->HasValue())
                {
                    m_logger.LogVerbose() << "RPort0::ReceiveEventimageDataEvent::GetNewSamples::" << recv->Value();
                }
                else
                {
                    m_logger.LogError() << "RPort0::ReceiveEventimageDataEvent::GetNewSamples::" << recv->Error().Message();
                }
            }
        }
        std::this_thread::sleep_for(std::chrono::seconds(1));
    }
}
 
void RPort0::ReadDataimageDataEvent(ara::com::SamplePtr<sensorCam::proxy::events::imageDataEvent::SampleType const> samplePtr)
{
    auto data = *samplePtr.Get();
    if (m_receiverimageDataEvent)
    {
        m_receiverimageDataEvent(data);
    }
}
 
void RPort0::RegistEventHandlerimageDataEvent(std::function<void(const sensorCam::proxy::events::imageDataEvent::SampleType&)> handler)
{
    m_receiverimageDataEvent = handler;
}
 
void RPort0::RequestrequestData(const bool& isRequest)
{
    if (m_found)
    {
        auto request = m_interface->requestData(isRequest);
        request.wait();
        auto response = request.GetResult();
        if (response.HasValue())
        {
            m_logger.LogVerbose() << "RPort0::RequestrequestData::Responded";
            
            auto result = response.Value();
            if (m_responderrequestData)
            {
                m_responderrequestData(result);
            }
        }
        else
        {
            m_logger.LogError() << "RPort0::RequestrequestData::" << response.Error().Message();
        }
    }
}
 
void RPort0::RegistResponseHandlerrequestData(std::function<void(const sensorCam::proxy::methods::requestData::Output&)> handler)
{
    m_responderrequestData = handler;
}
 
} /// namespace port
} /// namespace aa
} /// namespace clientsensor
 
/// EOF