///////////////////////////////////////////////////////////////////////////////////////////////////////////
///                                                                                                        
/// Copyright, 2021 PopcornSAR Co., Ltd. All rights reserved.                                              
/// This software is copyright protected and proprietary to PopcornSAR Co., Ltd.                           
/// PopcornSAR Co., Ltd. grants to you only those rights as set out in the license conditions.             
///                                                                                                        
///////////////////////////////////////////////////////////////////////////////////////////////////////////
/// AUTOSAR VERSION                   : R20-11
/// GENERATED BY                      : PARA, Adaptive Application Generator
///////////////////////////////////////////////////////////////////////////////////////////////////////////
/// GENERATED FILE NAME               : pport0.cpp
/// SOFTWARE COMPONENT NAME           : PPort0
/// GENERATED DATE                    : 2026-03-05 23:25:53
///////////////////////////////////////////////////////////////////////////////////////////////////////////
#include "providersensor/aa/port/pport0.h"
 
namespace sensorCam
{
namespace skeleton
{
 
SensorSkeletonImpl::SensorSkeletonImpl(ara::core::InstanceSpecifier instanceSpec, ara::com::MethodCallProcessingMode mode)
    : SensorSkeleton(instanceSpec, mode)
    , m_logger(ara::log::CreateLogger("pSen", "PORT", ara::log::LogLevel::kVerbose))
{
}
 
ara::core::Future<SensorSkeleton::requestDataOutput> SensorSkeletonImpl::requestData(const bool& isRequest)
{
    m_logger.LogVerbose() << "PPort0::requestData::Requested";
    
    requestDataOutput response;
    ara::core::Promise<requestDataOutput> promise;
    
    // put your logic
    
    promise.set_value(response);
    return promise.get_future();
}
 
} /// namespace skeleton
} /// namespace sensorCam

namespace providersensor
{
namespace aa
{
namespace port
{
 
PPort0::PPort0()
    : m_logger(ara::log::CreateLogger("pSen", "PORT", ara::log::LogLevel::kVerbose))
    , m_running{false}
    , m_imageDataEventData{0, 0, 0}
{
}
 
PPort0::~PPort0()
{
}
 
void PPort0::Start()
{
    m_logger.LogVerbose() << "PPort0::Start";
    
    // construct skeleton
    ara::core::InstanceSpecifier specifier{"ProviderSensor/AA/PPort0"};
    m_interface = std::make_unique<sensorCam::skeleton::SensorSkeletonImpl>(specifier);
    
    // offer service
    auto offer = m_interface->OfferService();
    if (offer.HasValue())
    {
        m_running = true;
        m_logger.LogVerbose() << "PPort0::Start::OfferService";
    }
    else
    {
        m_running = false;
        m_logger.LogError() << "PPort0::Start::OfferService::" << offer.Error().Message();
    }
}
 
void PPort0::Terminate()
{
    m_logger.LogVerbose() << "PPort0::Terminate";
    
    // stop port
    m_running = false;
    
    // stop offer service
    m_interface->StopOfferService();
    m_logger.LogVerbose() << "PPort0::Terminate::StopOfferService";
}
 
void PPort0::WriteDataimageDataEvent(const sensorCam::skeleton::events::imageDataEvent::SampleType& data)
{
    std::lock_guard<std::mutex> lock(m_mutex);
    
    m_imageDataEventData = data;
}
 
void PPort0::SendEventimageDataEventCyclic()
{
    while (m_running)
    {
        {
            std::lock_guard<std::mutex> lock(m_mutex);
            
            auto send = m_interface->imageDataEvent.Send(m_imageDataEventData);
            if (send.HasValue())
            {
                m_logger.LogVerbose() << "PPort0::SendEventimageDataEventCyclic::Send";
            }
            else
            {
                m_logger.LogError() << "PPort0::SendEventimageDataEventCyclic::Send::" << send.Error().Message();
            }
        }
        std::this_thread::sleep_for(std::chrono::seconds(1));
    }
}
 
void PPort0::SendEventimageDataEventTriggered()
{
    std::lock_guard<std::mutex> lock(m_mutex);
    
    auto send = m_interface->imageDataEvent.Send(m_imageDataEventData);
    if (send.HasValue())
    {
        m_logger.LogVerbose() << "PPort0::SendEventimageDataEventTriggered::Send";
    }
    else
    {
        m_logger.LogError() << "PPort0::SendEventimageDataEventTriggered::Send::" << send.Error().Message();
    }
}
 
void PPort0::SendEventimageDataEventTriggered(const sensorCam::skeleton::events::imageDataEvent::SampleType& data)
{
    std::lock_guard<std::mutex> lock(m_mutex);
    
    m_imageDataEventData = data;
    auto send = m_interface->imageDataEvent.Send(m_imageDataEventData);
    if (send.HasValue())
    {
        m_logger.LogVerbose() << "PPort0::SendEventimageDataEventTriggered::Send";
    }
    else
    {
        m_logger.LogError() << "PPort0::SendEventimageDataEventTriggered::Send::" << send.Error().Message();
    }
}
 
} /// namespace port
} /// namespace aa
} /// namespace providersensor
 
/// EOF