///////////////////////////////////////////////////////////////////////////////////////////////////////////
///                                                                                                        
/// Copyright, 2021 PopcornSAR Co., Ltd. All rights reserved.                                              
/// This software is copyright protected and proprietary to PopcornSAR Co., Ltd.                           
/// PopcornSAR Co., Ltd. grants to you only those rights as set out in the license conditions.             
///                                                                                                        
///////////////////////////////////////////////////////////////////////////////////////////////////////////
/// AUTOSAR VERSION                   : R20-11
/// GENERATED BY                      : PARA, Adaptive Application Generator
///////////////////////////////////////////////////////////////////////////////////////////////////////////
/// GENERATED FILE NAME               : sensorv2.cpp
/// SOFTWARE COMPONENT NAME           : Sensorv2
/// GENERATED DATE                    : 2025-11-24 18:44:15
///////////////////////////////////////////////////////////////////////////////////////////////////////////
#include "clientsensor/rootswcomponent/port/sensorv2.h"
 
namespace clientsensor
{
namespace rootswcomponent
{
namespace port
{
 
Sensorv2::Sensorv2()
    : m_logger(ara::log::CreateLogger("CLSENSR", "PORT", ara::log::LogLevel::kVerbose))
    , m_running{false}
    , m_found{false}
    , m_receiverEvent_RequestData{nullptr}
    , m_responderRequestData{nullptr}
{
}
 
Sensorv2::~Sensorv2()
{
}
 
void Sensorv2::Start()
{
    m_logger.LogVerbose() << "Sensorv2::Start";
    
    // regist callback
    ara::core::InstanceSpecifier specifier{"ClientSensor/RootSwComponent/Sensorv2"};
    auto handler = [this](ara::com::ServiceHandleContainer<sensor::transv2::proxy::transferData_v2Proxy::HandleType> handles,
                          ara::com::FindServiceHandle findHandle) {
        this->Find(handles, findHandle);
    };
    
    // find service
    auto find = sensor::transv2::proxy::transferData_v2Proxy::StartFindService(handler, specifier);
    if (find.HasValue())
    {
        m_logger.LogVerbose() << "Sensorv2::Start::StartFindService";
    }
    else
    {
        m_logger.LogError() << "Sensorv2::Start::StartFindService::" << find.Error().Message();
    }
    
    // run port
    m_running = true;
}
 
void Sensorv2::Terminate()
{
    m_logger.LogVerbose() << "Sensorv2::Terminate";
    
    // stop port
    m_running = false;
    
    // clear service proxy
    if (m_interface)
    {
        // stop subscribe
        StopSubscribeEvent_RequestData();
        
        // stop find service
        m_interface->StopFindService(*m_findHandle);
        m_found = false;
        
        m_logger.LogVerbose() << "Sensorv2::Terminate::StopFindService";
    }
}
 
void Sensorv2::Find(ara::com::ServiceHandleContainer<sensor::transv2::proxy::transferData_v2Proxy::HandleType> handles, ara::com::FindServiceHandle findHandle)
{
    // check finding handles
    if (handles.empty())
    {
        m_logger.LogVerbose() << "Sensorv2::Find::Service Instances not found";
        return;
    }
    else
    {
        for (auto& handle : handles)
        {
            m_logger.LogVerbose() << "Sensorv2::Find::Searched Instance::ServiceId =" << 
                                     handle.GetServiceHandle().serviceId << 
                                     ", InstanceId =" << 
                                     handle.GetServiceHandle().instanceId;
        }
    }
    
    // create proxy
    if (m_interface)
    {
        m_logger.LogVerbose() << "Sensorv2::Find::Proxy is already running";
    }
    else
    {
        m_logger.LogVerbose() << "Sensorv2::Find::Using Instance::ServiceId =" << 
                                 handles[0].GetServiceHandle().serviceId << 
                                 ", InstanceId =" << 
                                 handles[0].GetServiceHandle().instanceId;
        m_interface = std::make_unique<sensor::transv2::proxy::transferData_v2Proxy>(handles[0]);
        m_findHandle = std::make_unique<ara::com::FindServiceHandle>(findHandle);
        m_found = true;
        
        // subscribe events
        SubscribeEvent_RequestData();
    }
}
 
void Sensorv2::SubscribeEvent_RequestData()
{
    if (m_found)
    {
        // regist receiver handler
        // if you want to enable it, please uncomment below code
        // RegistReceiverEvent_RequestData();
        
        // request subscribe
        auto subscribe = m_interface->Event_RequestData.Subscribe(1);
        if (subscribe.HasValue())
        {
            m_logger.LogVerbose() << "Sensorv2::SubscribeEvent_RequestData::Subscribed";
        }
        else
        {
            m_logger.LogError() << "Sensorv2::SubscribeEvent_RequestData::" << subscribe.Error().Message();
        }
    }
}
 
void Sensorv2::StopSubscribeEvent_RequestData()
{
    if (m_found)
    {
        // request stop subscribe
        m_interface->Event_RequestData.Unsubscribe();
        m_logger.LogVerbose() << "Sensorv2::StopSubscribeEvent_RequestData::Unsubscribed";
    }
}
 
void Sensorv2::RegistReceiverEvent_RequestData()
{
    if (m_found)
    {
        // set callback
        auto receiver = [this]() -> void {
            return ReceiveEventEvent_RequestDataTriggered();
        };
        
        // regist callback
        auto callback = m_interface->Event_RequestData.SetReceiveHandler(receiver);
        if (callback.HasValue())
        {
            m_logger.LogVerbose() << "Sensorv2::RegistReceiverEvent_RequestData::SetReceiveHandler";
        }
        else
        {
            m_logger.LogError() << "Sensorv2::RegistReceiverEvent_RequestData::SetReceiveHandler::" << callback.Error().Message();
        }
    }
}
 
void Sensorv2::ReceiveEventEvent_RequestDataTriggered()
{
    if (m_found)
    {
        std::lock_guard<std::mutex> lock(m_mutex);
        
        if (m_interface->Event_RequestData.GetSubscriptionState() == ara::com::SubscriptionState::kSubscribed)
        {
            auto recv = std::make_unique<ara::core::Result<size_t>>(m_interface->Event_RequestData.GetNewSamples([&](auto samplePtr) {
                Sensorv2::ReadDataEvent_RequestData(std::move(samplePtr));
            }));
            if (recv->HasValue())
            {
                m_logger.LogVerbose() << "Sensorv2::ReceiveEventEvent_RequestData::GetNewSamples::" << recv->Value();
            }
            else
            {
                m_logger.LogError() << "Sensorv2::ReceiveEventEvent_RequestData::GetNewSamples::" << recv->Error().Message();
            }
        }
    }
}
 
void Sensorv2::ReceiveEventEvent_RequestDataCyclic()
{
    while (m_running)
    {
        if (m_found)
        {
            std::lock_guard<std::mutex> lock(m_mutex);
            if (m_interface->Event_RequestData.GetSubscriptionState() == ara::com::SubscriptionState::kSubscribed)
            {
                auto recv = std::make_unique<ara::core::Result<size_t>>(m_interface->Event_RequestData.GetNewSamples([&](auto samplePtr) {
                    Sensorv2::ReadDataEvent_RequestData(std::move(samplePtr));
                }));
                if (recv->HasValue())
                {
                    m_logger.LogVerbose() << "Sensorv2::ReceiveEventEvent_RequestData::GetNewSamples::" << recv->Value();
                }
                else
                {
                    m_logger.LogError() << "Sensorv2::ReceiveEventEvent_RequestData::GetNewSamples::" << recv->Error().Message();
                }
            }
        }
        std::this_thread::sleep_for(std::chrono::seconds(1));
    }
}
 
void Sensorv2::ReadDataEvent_RequestData(ara::com::SamplePtr<sensor::transv2::proxy::events::Event_RequestData::SampleType const> samplePtr)
{
    auto data = *samplePtr.Get();
    if (m_receiverEvent_RequestData)
    {
        m_receiverEvent_RequestData(data);
    }
}
 
void Sensorv2::RegistEventHandlerEvent_RequestData(std::function<void(const sensor::transv2::proxy::events::Event_RequestData::SampleType&)> handler)
{
    m_receiverEvent_RequestData = handler;
}
 
void Sensorv2::RequestRequestData(const bool& isRequest)
{
    if (m_found)
    {
        auto request = m_interface->RequestData(isRequest);
        request.wait();
        auto response = request.GetResult();
        if (response.HasValue())
        {
            m_logger.LogVerbose() << "Sensorv2::RequestRequestData::Responded";
            
            auto result = response.Value();
            if (m_responderRequestData)
            {
                m_responderRequestData(result);
            }
        }
        else
        {
            m_logger.LogError() << "Sensorv2::RequestRequestData::" << response.Error().Message();
        }
    }
}
 
void Sensorv2::RegistResponseHandlerRequestData(std::function<void(const sensor::transv2::proxy::methods::RequestData::Output&)> handler)
{
    m_responderRequestData = handler;
}
 
} /// namespace port
} /// namespace rootswcomponent
} /// namespace clientsensor
 
/// EOF