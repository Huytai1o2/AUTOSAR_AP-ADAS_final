///////////////////////////////////////////////////////////////////////////////////////////////////////////
///                                                                                                        
/// Copyright, 2021 PopcornSAR Co., Ltd. All rights reserved.                                              
/// This software is copyright protected and proprietary to PopcornSAR Co., Ltd.                           
/// PopcornSAR Co., Ltd. grants to you only those rights as set out in the license conditions.             
///                                                                                                        
///////////////////////////////////////////////////////////////////////////////////////////////////////////
/// AUTOSAR VERSION                   : R20-11
/// GENERATED BY                      : PARA, Adaptive Application Generator
///////////////////////////////////////////////////////////////////////////////////////////////////////////
/// GENERATED FILE NAME               : sensorv2.cpp
/// SOFTWARE COMPONENT NAME           : Sensorv2
/// GENERATED DATE                    : 2025-11-24 18:44:15
///////////////////////////////////////////////////////////////////////////////////////////////////////////
#include "providersensor/rootswcomponent/port/sensorv2.h"
 
namespace sensor
{
namespace transv2
{
namespace skeleton
{
 
transferData_v2SkeletonImpl::transferData_v2SkeletonImpl(ara::core::InstanceSpecifier instanceSpec, ara::com::MethodCallProcessingMode mode)
    : transferData_v2Skeleton(instanceSpec, mode)
    , m_logger(ara::log::CreateLogger("PVSENSR", "PORT", ara::log::LogLevel::kVerbose))
{
}
 
ara::core::Future<transferData_v2Skeleton::RequestDataOutput> transferData_v2SkeletonImpl::RequestData(const bool& isRequest)
{
    m_logger.LogVerbose() << "Sensorv2::RequestData::Requested";
    
    RequestDataOutput response;
    ara::core::Promise<RequestDataOutput> promise;
    
    // put your logic
    
    promise.set_value(response);
    return promise.get_future();
}
 
} /// namespace skeleton
} /// namespace transv2
} /// namespace sensor

namespace providersensor
{
namespace rootswcomponent
{
namespace port
{
 
Sensorv2::Sensorv2()
    : m_logger(ara::log::CreateLogger("PVSENSR", "PORT", ara::log::LogLevel::kVerbose))
    , m_running{false}
    , m_Event_RequestDataData{0U, 0U, 0U}
{
}
 
Sensorv2::~Sensorv2()
{
}
 
void Sensorv2::Start()
{
    m_logger.LogVerbose() << "Sensorv2::Start";
    
    // construct skeleton
    ara::core::InstanceSpecifier specifier{"ProviderSensor/RootSwComponent/Sensorv2"};
    m_interface = std::make_unique<sensor::transv2::skeleton::transferData_v2SkeletonImpl>(specifier);
    
    // offer service
    auto offer = m_interface->OfferService();
    if (offer.HasValue())
    {
        m_running = true;
        m_logger.LogVerbose() << "Sensorv2::Start::OfferService";
    }
    else
    {
        m_running = false;
        m_logger.LogError() << "Sensorv2::Start::OfferService::" << offer.Error().Message();
    }
}
 
void Sensorv2::Terminate()
{
    m_logger.LogVerbose() << "Sensorv2::Terminate";
    
    // stop port
    m_running = false;
    
    // stop offer service
    m_interface->StopOfferService();
    m_logger.LogVerbose() << "Sensorv2::Terminate::StopOfferService";
}
 
void Sensorv2::WriteDataEvent_RequestData(const sensor::transv2::skeleton::events::Event_RequestData::SampleType& data)
{
    std::lock_guard<std::mutex> lock(m_mutex);
    
    m_Event_RequestDataData = data;
}
 
void Sensorv2::SendEventEvent_RequestDataCyclic()
{
    while (m_running)
    {
        {
            std::lock_guard<std::mutex> lock(m_mutex);
            
            auto send = m_interface->Event_RequestData.Send(m_Event_RequestDataData);
            if (send.HasValue())
            {
                m_logger.LogVerbose() << "Sensorv2::SendEventEvent_RequestDataCyclic::Send";
            }
            else
            {
                m_logger.LogError() << "Sensorv2::SendEventEvent_RequestDataCyclic::Send::" << send.Error().Message();
            }
        }
        std::this_thread::sleep_for(std::chrono::seconds(1));
    }
}
 
void Sensorv2::SendEventEvent_RequestDataTriggered()
{
    std::lock_guard<std::mutex> lock(m_mutex);
    
    auto send = m_interface->Event_RequestData.Send(m_Event_RequestDataData);
    if (send.HasValue())
    {
        m_logger.LogVerbose() << "Sensorv2::SendEventEvent_RequestDataTriggered::Send";
    }
    else
    {
        m_logger.LogError() << "Sensorv2::SendEventEvent_RequestDataTriggered::Send::" << send.Error().Message();
    }
}
 
void Sensorv2::SendEventEvent_RequestDataTriggered(const sensor::transv2::skeleton::events::Event_RequestData::SampleType& data)
{
    std::lock_guard<std::mutex> lock(m_mutex);
    
    m_Event_RequestDataData = data;
    auto send = m_interface->Event_RequestData.Send(m_Event_RequestDataData);
    if (send.HasValue())
    {
        m_logger.LogVerbose() << "Sensorv2::SendEventEvent_RequestDataTriggered::Send";
    }
    else
    {
        m_logger.LogError() << "Sensorv2::SendEventEvent_RequestDataTriggered::Send::" << send.Error().Message();
    }
}
 
} /// namespace port
} /// namespace rootswcomponent
} /// namespace providersensor
 
/// EOF