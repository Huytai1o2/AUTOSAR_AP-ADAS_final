AUTOSAR XML (schema 00049)
package /SwComponent/AdaptiveApplication
  adaptive application sw component type CM
  adaptive application sw component type EM
package /AdaptiveApplication/DltConfig
  dlt log channel to process mapping DltLogChannelToProcessMapping_CM_TO_CM: dlt-log-channel=CM, process=CM
  dlt log channel to process mapping DltLogChannelToProcessMapping_EM_TO_EM: dlt-log-channel=EM, process=EM
package /AdaptiveApplication/Executable
  executable CM: category=PLATFORM_LEVEL, logging-behavior=USES-LOGGING, reporting-behavior=REPORTS-EXECUTION-STATE, version=1.0.0
    root sw component prototype PARA: application-type=CM
  executable EM: category=PLATFORM_LEVEL, logging-behavior=USES-LOGGING, reporting-behavior=DOES-NOT-REPORT-EXECUTION-STATE, version=1.0.0
    root sw component prototype PARA: application-type=EM
package /AdaptiveApplication/Process
  process CM: executable=CM, state-dependent-startup-config{function-group-state=[MachineFG.Startup, MachineFG.Restart, MachineFG.Shutdown, MachineFG.Verify], resource-group=ResourceGroup, startup-config=CM}
    process state machine CM: type=ProcessState
  process EM: executable=EM
package /AdaptiveApplication/StartupConfig
  startup config set StartupConfig
    startup config CM: scheduling-policy=SCHED_OTHER, scheduling-priority=0, timeout={enter-timeout-value=1.0, exit-timeout-value=1.0}
    startup config ClientSensor: scheduling-policy=SCHED_OTHER, scheduling-priority=0, timeout={enter-timeout-value=1.0, exit-timeout-value=1.0}
    startup config ProviderSensor: scheduling-policy=SCHED_OTHER, scheduling-priority=0, timeout={enter-timeout-value=1.0, exit-timeout-value=1.0}
package /DataType/Implementation/CPP
  36 x std cpp implementation data type:
    ActionType: compu {0x00=kUpdate, 0x01=kInstall, 0x02=kRemove}, type-reference=uint8_t
      namespaces:
        symbol props ara
        symbol props ucm
    ByteVectorType: category=VECTOR, cpp-template-argument=uint8_t
      namespaces:
        symbol props ara
        symbol props ucm
    CampaignErrorType: category=STRUCTURE
      namespaces:
        symbol props ara
        symbol props ucm
      cpp implementation data type element CampaignFailure: type-reference=CampaignFailureType
      cpp implementation data type element UCMStepError: type-reference=UCMStepErrorType
    CampaignFailureType: compu {0x01=kUCMError, 0x02=kInvalidVehiclePackageManifest, 0x03=kSubordinateNotAvailableOnTheNetwork, 0x04=kVehicleStateManagerCommunicationError, 0x05=kVehicleDriverInterfaceCommunicationError, 0x06=kCampaignCancelled}, type-reference=uint8_t
      namespaces:
        symbol props ara
        symbol props ucm
    CampaignHistoryType: category=STRUCTURE
      namespaces:
        symbol props ara
        symbol props ucm
      cpp implementation data type element CampaignError: type-reference=CampaignErrorType
      cpp implementation data type element HistoryVector: type-reference=HistoryVectorType
    CampaignStateType: compu {0x00=kIdle, 0x01=kSyncing, 0x02=kVehiclePackageTransferring, 0x03=kSoftwarePackageTransferring, 0x04=kProcessing, 0x05=kActivating, 0x06=kVehicleChecking, 0x07=kCancelling}, type-reference=uint8_t
      namespaces:
        symbol props ara
        symbol props ucm
    FGNameType: category=STRING
      namespaces:
        symbol props ara
        symbol props sm
    FunctionGroupList: category=VECTOR, cpp-template-argument=FGNameType
      namespaces:
        symbol props ara
        symbol props sm
    GetHistoryType: category=STRUCTURE
      namespaces:
        symbol props ara
        symbol props ucm
      5 x cpp implementation data type element:
        Time: type-reference=uint64_t
        Name: type-reference=SwNameType
        Version: type-reference=StrongRevisionLabelString
        Action: type-reference=ActionType
        Resolution: type-reference=ResultType
    GetHistoryVectorType: category=VECTOR, cpp-template-argument=GetHistoryType
      namespaces:
        symbol props ara
        symbol props ucm
    HistoryVectorType: category=STRUCTURE
      namespaces:
        symbol props ara
        symbol props ucm
      cpp implementation data type element id: type-reference=UCMIdentifierType
      cpp implementation data type element HistoryVector: type-reference=GetHistoryVectorType
    LicenseString: category=STRING
      namespaces:
        symbol props ara
        symbol props ucm
    MachineState: compu {0x00=kOff, 0x01=kStartup, 0x02=kShutdown, 0x03=kRestart, 0x04=kVerify}, type-reference=uint8_t
      namespaces:
        symbol props ara
        symbol props sm
    PackageManagerStatusType: compu {0x00=kIdle, 0x01=kReady, 0x02=kProcessing, 0x03=kActivating, 0x04=kActivated, 0x05=kRollingBack, 0x06=kRolledBack, 0x07=kCleaningUp, 0x08=kVerifying}, type-reference=uint8_t
      namespaces:
        symbol props ara
        symbol props ucm
    ReleaseNotesString: category=STRING
      namespaces:
        symbol props ara
        symbol props ucm
    ResultType: compu {0x00=kSuccessfull, 0x01=kFailed}, type-reference=uint8_t
      namespaces:
        symbol props ara
        symbol props ucm
    SafetyPolicyType: category=STRING
      namespaces:
        symbol props ara
        symbol props ucm
    SoftwarePackageStepType: compu {0x00=kTransfer, 0x01=kProcess, 0x02=kPreActivate, 0x03=kVerify}, type-reference=uint8_t
      namespaces:
        symbol props ara
        symbol props ucm
    StrongRevisionLabelString: category=STRING
      namespaces:
        symbol props ara
        symbol props ucm
    SwClusterInfoType: category=STRUCTURE
      namespaces:
        symbol props ara
        symbol props ucm
      cpp implementation data type element Name: type-reference=SwNameType
      cpp implementation data type element Version: type-reference=StrongRevisionLabelString
      cpp implementation data type element State: type-reference=SwClusterStateType
    SwClusterInfoVectorType: category=VECTOR, cpp-template-argument=SwClusterInfoType
      namespaces:
        symbol props ara
        symbol props ucm
    SwClusterStateType: compu {0x00=kPresent, 0x01=kAdded, 0x02=kUpdated, 0x03=kRemoved}, type-reference=uint8_t
      namespaces:
        symbol props ara
        symbol props ucm
    SwDescType: category=STRUCTURE
      namespaces:
        symbol props ara
        symbol props ucm
      6 x cpp implementation data type element:
        Name: type-reference=SwNameType
        Version: type-reference=StrongRevisionLabelString
        TypeApproval: type-reference=TypeApprovalString
        License: type-reference=LicenseString
        ReleaseNotes: type-reference=ReleaseNotesString
        Size: type-reference=uint64_t
    SwDescVectorType: category=VECTOR, cpp-template-argument=SwDescType
      namespaces:
        symbol props ara
        symbol props ucm
    SwNameType: category=STRING
      namespaces:
        symbol props ara
        symbol props ucm
    SwNameVectorType: category=VECTOR, cpp-template-argument=SwNameType
      namespaces:
        symbol props ara
        symbol props ucm
    SwNameVersionType: category=STRUCTURE
      namespaces:
        symbol props ara
        symbol props ucm
      cpp implementation data type element Name: type-reference=SwNameType
      cpp implementation data type element Version: type-reference=StrongRevisionLabelString
    SwNameVersionVectorType: category=VECTOR, cpp-template-argument=SwNameVersionType
      namespaces:
        symbol props ara
        symbol props ucm
    SwPackageInfoType: category=STRUCTURE
      namespaces:
        symbol props ara
        symbol props ucm
      6 x cpp implementation data type element:
        Name: type-reference=SwNameType
        Version: type-reference=StrongRevisionLabelString
        TransferID: type-reference=TransferIdType
        ConsecutiveBytesReceived: type-reference=uint64_t
        ConsecutiveBlocksReceived: type-reference=uint64_t
        State: type-reference=SwPackageStateType
    SwPackageInfoVectorType: category=VECTOR, cpp-template-argument=SwPackageInfoType
      namespaces:
        symbol props ara
        symbol props ucm
    SwPackageStateType: compu {0x00=kTransferring, 0x01=kTransferred, 0x02=kProcessing, 0x03=kProcessed, 0x04=kProcessingStream}, type-reference=uint8_t
      namespaces:
        symbol props ara
        symbol props ucm
    TransferIdType: category=ARRAY, array-size=16, cpp-template-argument=uint8_t
      namespaces:
        symbol props ara
        symbol props ucm
    TransferStateType: compu {0x00=kIdle, 0x01=kTransferring, 0x02=kUpdating, 0x03=kCancelling}, type-reference=uint8_t
      namespaces:
        symbol props ara
        symbol props ucm
    TypeApprovalString: category=STRING
      namespaces:
        symbol props ara
        symbol props ucm
    UCMIdentifierType: category=STRING
      namespaces:
        symbol props ara
        symbol props ucm
    UCMStepErrorType: category=STRUCTURE
      namespaces:
        symbol props ara
        symbol props ucm
      cpp implementation data type element id: type-reference=UCMIdentifierType
      cpp implementation data type element SoftwarePackageStep: type-reference=SoftwarePackageStepType
      cpp implementation data type element ReturnedError: type-reference=uint64_t
package /PortInterface/Service
  5 x service interface:
    PackageManagement
      namespaces:
        symbol props ara
        symbol props ucm
        symbol props pkgmgr
      field CurrentStatus: type=PackageManagerStatusType, has-getter=true, has-notifier=true, has-setter=false
      methods:
        17 x operation, all with fire-and-forget=false:
          Activate: possible-ap-error=[MissingDependencies, OperationNotPermitted, PreActivationFailed, UpdateSessionRejected, VerificationFailed]
          Cancel: possible-ap-error=[CancelFailed, InvalidTransferId, OperationNotPermitted]
            arg id: type=TransferIdType, direction=IN
          DeleteTransfer: possible-ap-error=[InvalidTransferId, OperationNotPermitted]
            arg id: type=TransferIdType, direction=IN
          Finish: possible-ap-error=OperationNotPermitted
          GetHistory
            arg timestampGE: type=uint64_t, direction=IN
            arg timestampLT: type=uint64_t, direction=IN
            arg history: type=GetHistoryVectorType, direction=OUT
          GetId
            arg id: type=UCMIdentifierType, direction=OUT
          GetSwClusterChangeInfo
            arg SwInfo: type=SwClusterInfoVectorType, direction=OUT
          GetSwClusterDescription
            arg SwCluster: type=SwDescVectorType, direction=OUT
          GetSwClusterInfo
            arg SwInfo: type=SwClusterInfoVectorType, direction=OUT
          GetSwPackages
            arg Packages: type=SwPackageInfoVectorType, direction=OUT
          GetSwProcessProgress: possible-ap-error=InvalidTransferId
            arg id: type=TransferIdType, direction=IN
            arg progress: type=uint8_t, direction=OUT
          ProcessSwPackage: possible-ap-error=[AuthenticationFailed, IncompatibleDelta, IncompatiblePackageVersion, InsufficientComputationPower, InsufficientMemory, InvalidPackageManifest, InvalidTransferId, OperationNotPermitted, ProcessSwPackageCancelled, ProcessedSoftwarePackageInconsistent, ServiceBusy]
            arg id: type=TransferIdType, direction=IN
          RevertProcessedSwPackages: possible-ap-error=[NotAbleToRevertPackages, OperationNotPermitted]
          Rollback: possible-ap-error=[NotAbleToRollback, OperationNotPermitted]
          TransferData: possible-ap-error=[AuthenticationFailed, BlockInconsistent, IncompatiblePackageVersion, IncorrectBlock, IncorrectBlockSize, IncorrectSize, InsufficientComputationPower, InsufficientMemory, InvalidTransferId, OperationNotPermitted, PackageInconsistent, TransferInterrupted]
            arg id: type=TransferIdType, direction=IN
            arg data: type=ByteVectorType, direction=IN
            arg blockCounter: type=uint64_t, direction=IN
          TransferExit: possible-ap-error=[AuthenticationFailed, IncompatiblePackageVersion, InsufficientData, InvalidPackageManifest, InvalidTransferId, MissingDependencies, OldVersion, OperationNotPermitted, PackageInconsistent]
            arg id: type=TransferIdType, direction=IN
          TransferStart: possible-ap-error=[InsufficientComputationPower, InsufficientMemory]
            arg size: type=uint64_t, direction=IN
            arg id: type=TransferIdType, direction=OUT
            arg BlockSize: type=uint32_t, direction=OUT
    TriggerInOut_MachineFG
      namespaces:
        symbol props ara
        symbol props sm
        symbol props machinefg
      field Notifier: type=MachineState, has-getter=true, has-notifier=true, has-setter=false
      field Trigger: type=MachineState, has-getter=false, has-notifier=false, has-setter=true
    UpdateRequest
      namespaces:
        symbol props ara
        symbol props sm
        symbol props update
      methods:
        6 x operation:
          PrepareRollback: fire-and-forget=false, possible-ap-error=[kRejected, kRollbackFailed]
            arg FunctionGroupList: type=FunctionGroupList, direction=IN
          PrepareUpdate: fire-and-forget=false, possible-ap-error=[kPrepareFailed, kRejected]
            arg FunctionGroupList: type=FunctionGroupList, direction=IN
          ResetMachine: fire-and-forget=false, possible-ap-error=kRejected
          StartUpdateSession: fire-and-forget=false, possible-ap-error=kRejected
          StopUpdateSession: fire-and-forget=true
          VerifyUpdate: fire-and-forget=false, possible-ap-error=[kRejected, kVerifyFailed]
            arg FunctionGroupList: type=FunctionGroupList, direction=IN
    VehicleDriverApplication
      namespaces:
        symbol props ara
        symbol props ucm
        symbol props driver
      4 x field, all with has-getter=true, has-notifier=true, has-setter=false:
        ApprovalRequired: type=bool
        CampaignState: type=CampaignStateType
        SafetyPolicy: type=SafetyPolicyType
        SafetyState: type=bool
      methods:
        8 x operation, all with fire-and-forget=false:
          AllowCampaign
          CancelCampaign: possible-ap-error=[CancelFailed, InvalidTransferId, OperationNotPermitted]
            arg DisableCampaign: type=bool, direction=IN
          DriverApproval
            arg Approval: type=bool, direction=IN
            arg SafetyPolicy: type=SafetyPolicyType, direction=IN
          GetCampaignHistory
            arg timestampGE: type=uint64_t, direction=IN
            arg timestampLT: type=uint64_t, direction=IN
            arg history: type=CampaignHistoryType, direction=OUT
          GetSwClusterDescription
            arg SoftwareClusterDescriptions: type=SwDescVectorType, direction=OUT
          GetSwPackageDescription
            arg Packages: type=SwDescVectorType, direction=OUT
          GetSwProcessProgress
            arg progress: type=uint8_t, direction=OUT
          GetSwTransferProgress
            arg progress: type=uint8_t, direction=OUT
    VehiclePackageManagement
      namespaces:
        symbol props ara
        symbol props ucm
        symbol props vehpkgmgr
      field RequestedPackage: type=SwNameVersionType, has-getter=true, has-notifier=true, has-setter=false
      field SafetyState: type=bool, has-getter=true, has-notifier=true, has-setter=false
      field TransferState: type=TransferStateType, has-getter=true, has-notifier=true, has-setter=false
      methods:
        11 x operation, all with fire-and-forget=false:
          AllowCampaign
          CancelCampaign: possible-ap-error=[CancelFailed, InvalidTransferId, OperationNotPermitted]
            arg DisableCampaign: type=bool, direction=IN
          DeleteTransfer
            arg id: type=TransferIdType, direction=IN
          GetCampaignHistory
            arg timestampGE: type=uint64_t, direction=IN
            arg timestampLT: type=uint64_t, direction=IN
            arg CampaignHistory: type=CampaignHistoryType, direction=OUT
          GetSwClusterInfo
            arg SwInfo: type=SwClusterInfoVectorType, direction=OUT
          GetSwPackages
            arg Packages: type=SwPackageInfoVectorType, direction=OUT
          SwPackageInventory
            arg AvailableSoftwarePackages: type=SwNameVersionVectorType, direction=IN
            arg RequiredSoftwarePackages: type=SwNameVersionVectorType, direction=OUT
          TransferData: possible-ap-error=[AuthenticationFailed, BlockInconsistent, IncompatiblePackageVersion, IncorrectBlock, IncorrectBlockSize, IncorrectSize, InsufficientComputationPower, InsufficientMemory, InvalidTransferId, OperationNotPermitted, PackageInconsistent, TransferInterrupted]
            arg id: type=TransferIdType, direction=IN
            arg data: type=ByteVectorType, direction=IN
            arg blockCounter: type=uint64_t, direction=IN
          TransferExit: possible-ap-error=[AuthenticationFailed, IncompatiblePackageVersion, InsufficientData, InvalidPackageManifest, InvalidTransferId, MissingDependencies, OldVersion, OperationNotPermitted, PackageInconsistent]
            arg id: type=TransferIdType, direction=IN
          TransferStart: possible-ap-error=[InsufficientComputationPower, InsufficientMemory, UnexpectedPackage]
            4 x arg:
              SoftwarePackageName: type=SwNameType, direction=IN
              size: type=uint64_t, direction=IN
              id: type=TransferIdType, direction=OUT
              BlockSize: type=uint32_t, direction=OUT
          TransferVehiclePackage: possible-ap-error=[InsufficientMemory, NewCampaignDisabled]
            arg size: type=uint64_t, direction=IN
            arg id: type=TransferIdType, direction=OUT
            arg BlockSize: type=uint32_t, direction=OUT
package /PortInterface/Service/ErrorDomain
  23 x ap application error, all with error-domain=UCMErrorDomain:
    AuthenticationFailed: error-code=8
    BlockInconsistent: error-code=25
    CancelFailed: error-code=16
    IncompatibleDelta: error-code=29
    IncompatiblePackageVersion: error-code=24
    IncorrectBlock: error-code=2
    IncorrectBlockSize: error-code=30
    IncorrectSize: error-code=3
    InsufficientComputationPower: error-code=28
    InsufficientData: error-code=6
    InsufficientMemory: error-code=1
    InvalidPackageManifest: error-code=13
    InvalidTransferId: error-code=4
    MissingDependencies: error-code=21
    NewCampaignDisabled: error-code=31
    NotAbleToRevertPackages: error-code=15
    NotAbleToRollback: error-code=18
    OldVersion: error-code=9
    OperationNotPermitted: error-code=5
    PackageInconsistent: error-code=7
    PreActivationFailed: error-code=19
    ProcessSwPackageCancelled: error-code=22
    ProcessedSoftwarePackageInconsistent: error-code=23
  ap application error domain SMErrorDomain: value=13835058055282163729
  ap application error ServiceBusy: error-code=12, error-domain=UCMErrorDomain
  ap application error TransferInterrupted: error-code=26, error-domain=UCMErrorDomain
  ap application error domain UCMErrorDomain: value=13835058055282164000
  7 x ap application error:
    UnexpectedPackage: error-code=32, error-domain=UCMErrorDomain
    UpdateSessionRejected: error-code=33, error-domain=UCMErrorDomain
    VerificationFailed: error-code=27, error-domain=UCMErrorDomain
    kPrepareFailed: error-code=7, error-domain=SMErrorDomain
    kRejected: error-code=5, error-domain=SMErrorDomain
    kRollbackFailed: error-code=8, error-domain=SMErrorDomain
    kVerifyFailed: error-code=6, error-domain=SMErrorDomain
package /Platform
  machine HPC_Machine: machine-design=HPC, trusted-platform-executable-launch-behavior=NO-TRUSTED-PLATFORM-SUPPORT
    module-instantiations:
      generic module instantiation CmInstantiation: category=COMMUNICATION_MANAGEMENT
      log and trace instantiation LOG: dlt-ecu-id=ECU
        4 x dlt log channel, all with log-trace-log-modes=CONSOLE:
          CM: application-id=CM, context-id=CM, log-trace-default-log-level=ERROR
          ClientSensor: application-id=CLSENSR, context-id=CLSENSR, log-trace-default-log-level=VERBOSE
          EM: application-id=EM, context-id=EM, log-trace-default-log-level=ERROR
          ProviderSensor: application-id=PVSENSR, context-id=PVSENSR, log-trace-default-log-level=VERBOSE
      os module instantiation POSIX
        resource group ResourceGroup
    processor CPU
      processor core CORE: core-id=0
package /Platform/FunctionGroup
  function group set FunctionGroupSet
    function-groups:
      mode declaration group prototype MachineFG: type=MachineState
package /Platform/PlatformHealth
  platform health management contribution Phm
  phm contribution to machine mapping PhmContributionToMachineMapping: machine=HPC_Machine, phm-contribution=Phm
package /Platform/ProcessToMachine
  process to machine mapping set ProcessToMachineMappingSet
    4 x process to machine mapping, all with machine=HPC_Machine:
      CM_To_HPC_Machine_Mapping: process=CM
      ClientSensor_To_HPC_Machine_Mapping: process=ClientSensor
      ProcessToMachineMapping_EM_TO_Ecu1Machine_TO_UnknownModule: process=EM
      ProviderSensor_To_HPC_Machine_Mapping: process=ProviderSensor
package /StateMachine
  mode declaration group MachineState: initial-mode=Off
    5 x mode:
      Off
      Restart
      Shutdown
      Startup
      Verify
  mode declaration group ProcessState: initial-mode=Idle
    4 x mode:
      Idle
      Running
      Starting
      Terminated
