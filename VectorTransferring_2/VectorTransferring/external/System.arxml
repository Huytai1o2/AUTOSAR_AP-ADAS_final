AUTOSAR XML (schema 00049)
package /SwComponent/Composition
  composition sw component type HPC
    4 x component:
      CM: type=CM
      ClientSensor: type=ClientSensor
      EM: type=EM
      ProviderSensor: type=ProviderSensor
  composition sw component type System
    component HPC: type=HPC
package /System
  system System: category=MACHINE_DESIGN_EXTRACT, system-version=1.0.0;R2011-PARA
    system mapping SystemMapping
      sw-mappings:
        swc to ecu mapping SwMapping0: component=System.HPC.HPC
    root-software-compositions:
      root sw composition prototype System: software-composition=System
package /System/CryptoGraphy/Certificate
  crypto service certificate ParaCertificate
package /System/Service/TimingConfig
  someip sd client service instance config AAClientConfig: initial-find-behavior={initial-delay-max-value=0.1, initial-delay-min-value=0.1, initial-repetitions-base-delay=0.1, initial-repetitions-max=3}, service-find-time-to-live=16777215
  someip sd server service instance config AASdServerConfig: initial-offer-behavior={initial-delay-max-value=0.1, initial-delay-min-value=0.1, initial-repetitions-base-delay=0.1, initial-repetitions-max=2}, offer-cyclic-delay=0.5, request-response-delay={max-value=0.0, min-value=0.0}, service-offer-time-to-live=16777215
  someip sd client event group timing config AASdSubscribeConfig: request-response-delay={max-value=0.0, min-value=0.0}, time-to-live=16777215
  someip sd client service instance config SmClientConfig: initial-find-behavior={initial-delay-max-value=0.1, initial-delay-min-value=0.1, initial-repetitions-base-delay=0.1, initial-repetitions-max=4}, service-find-time-to-live=16777215
  someip sd server event group timing config SmSdPublishConfig: request-response-delay={max-value=0.0, min-value=0.0}
  someip sd client event group timing config SmSdSubscribeConfig: request-response-delay={max-value=0.0, min-value=0.0}, time-to-live=16777215
  someip sd server service instance config SmServerConfig: initial-offer-behavior={initial-delay-max-value=0.1, initial-delay-min-value=0.1, initial-repetitions-base-delay=0.1, initial-repetitions-max=3}, offer-cyclic-delay=0.5, request-response-delay={max-value=0.0, min-value=0.0}, service-offer-time-to-live=16777215
  someip sd client service instance config UcmClientConfig: initial-find-behavior={initial-delay-max-value=0.1, initial-delay-min-value=0.1, initial-repetitions-base-delay=0.1, initial-repetitions-max=4}, service-find-time-to-live=16777215
  someip sd server event group timing config UcmSdPublishConfig: request-response-delay={max-value=0.0, min-value=0.0}
  someip sd client event group timing config UcmSdSubscribeConfig: request-response-delay={max-value=0.0, min-value=0.0}, time-to-live=16777215
  someip sd server service instance config UcmServerConfig: initial-offer-behavior={initial-delay-max-value=0.1, initial-delay-min-value=0.1, initial-repetitions-base-delay=0.1, initial-repetitions-max=3}, offer-cyclic-delay=0.5, request-response-delay={max-value=0.0, min-value=0.0}, service-offer-time-to-live=16777215
package /System/VehicleTopology/Cluster
  ethernet cluster EthernetCluster
    ethernet physical channel PhysicalChannel: category=WIRED, comm-connectors=eth0
      network endpoint HPCEndpoint: network-endpoint-addresses=ipv-4-configuration={ipv-4-address=172.31.36.143, ipv-4-address-source=FIXED}
      network endpoint SdMulticast: network-endpoint-addresses=ipv-4-configuration={ipv-4-address=224.0.0.1, ipv-4-address-source=FIXED}
package /System/VehicleTopology/Ecu
  machine design HPC: service-discover-configs=someip-service-discovery={multicast-sd-ip-address=SdMulticast, someip-service-discovery-port=30490}
    user defined communication connector IPC
    ethernet communication connector eth0: unicast-network-endpoint=HPCEndpoint
