AUTOSAR XML (schema 00049)
standard types defined: boolean, float32, float64, sint16, sint32, sint64, sint8, uint16, uint32, uint64, uint8, sint16_least, sint32_least, sint8_least, uint16_least, uint32_least, uint8_least
package /DataType/Application
  12 x app type:
    Boolean: category=BOOLEAN, compu {0=FALSE, 1=TRUE}, range raw 0..1
    Float32: category=VALUE, range raw -3.4028235e+38..3.4028235e+38
    Float64: category=VALUE, range raw -1.7976931348623157e+308..1.7976931348623157e+308
    SInt16: category=VALUE, range raw -32768..32767
    SInt32: category=VALUE, range raw -2147483648..2147483647
    SInt64: category=VALUE, range raw -9223372036854775808..9223372036854775807
    SInt8: category=VALUE, range raw -128..127
    String: category=STRING, sw-text-props={array-size-semantics=VARIABLE-SIZE, sw-max-text-size=255}
    UInt16: category=VALUE, range raw 0..65535
    UInt32: category=VALUE, range raw 0..4294967295
    UInt64: category=VALUE, range raw 0..18446744073709551615
    UInt8: category=VALUE, range raw 0..255
package /DataType/Implementation/C
  impl type ConstVoidPtr: category=DATA_REFERENCE, sw-pointer-target-props={target-category=VALUE, base-type=ConstVoidPtr, sw-impl-policy=CONST}
  impl type VoidPtr: category=DATA_REFERENCE, sw-pointer-target-props={target-category=VALUE, base-type=VoidPtr}
package /DataType/Implementation/CPP
  11 x std cpp implementation data type, all with category=VALUE:
    bool: type-emitter=FundamentalType
    double: type-emitter=FundamentalType
    float: type-emitter=FundamentalType
    int16_t: header-file=cstdint
    int32_t: header-file=cstdint
    int64_t: header-file=cstdint
    int8_t: header-file=cstdint
    uint16_t: header-file=cstdint
    uint32_t: header-file=cstdint
    uint64_t: header-file=cstdint
    uint8_t: header-file=cstdint
package /DataType/Mapping
  data type mapping set ApDataTypeMapping
    data-type-maps:
      application-data-type=Boolean, implementation-data-type=bool
      application-data-type=UInt8, implementation-data-type=uint8_t
      application-data-type=UInt16, implementation-data-type=uint16_t
      application-data-type=UInt32, implementation-data-type=uint32_t
      application-data-type=UInt64, implementation-data-type=uint64_t
      application-data-type=SInt8, implementation-data-type=int8_t
      application-data-type=SInt16, implementation-data-type=int16_t
      application-data-type=SInt32, implementation-data-type=int32_t
      application-data-type=SInt64, implementation-data-type=int64_t
      application-data-type=Float32, implementation-data-type=float
      application-data-type=Float64, implementation-data-type=double
  data type mapping set CpDataTypeMapping
    data-type-maps:
      application-data-type=Boolean, implementation-data-type=boolean
      application-data-type=UInt8, implementation-data-type=uint8
      application-data-type=UInt16, implementation-data-type=uint16
      application-data-type=UInt32, implementation-data-type=uint32
      application-data-type=UInt64, implementation-data-type=uint64
      application-data-type=SInt8, implementation-data-type=sint8
      application-data-type=SInt16, implementation-data-type=sint16
      application-data-type=SInt32, implementation-data-type=sint32
      application-data-type=SInt64, implementation-data-type=sint64
      application-data-type=Float32, implementation-data-type=float32
      application-data-type=Float64, implementation-data-type=float64
package /DataType/SwBase
  base type ConstVoidPtr: category=FIXED_LENGTH, base-type-size=1, base-type-encoding=VOID, native-declaration=void
  base type VoidPtr: category=FIXED_LENGTH, base-type-size=1, base-type-encoding=VOID, native-declaration=void
